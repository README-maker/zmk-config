## config/west.yml
```yaml
manifest:
  remotes:
    - name: zmkfirmware
      url-base: https://github.com/zmkfirmware
    - name: nxtkb
      url-base: https://github.com/nxtkb
  projects:
    - name: zmk
      remote: zmkfirmware
      revision: v0.6.0  # 把这里从 main 改成 v0.6.0
      import: app/west.yml
    - name: zmk-behavior-report
      remote: nxtkb
      revision: main
      import: west.yml
  self:
    path: config
```
